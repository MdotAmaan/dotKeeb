## config/Kconfig.shield
```kconfig
config SHIELD_DOTKEEB_LEFT
    def_bool $(shields_list_contains,dotkeeb_left)

config SHIELD_DOTKEEB_RIGHT
    def_bool $(shields_list_contains,dotkeeb_right)
```

## config/boards/shields/dotkeeb/Kconfig.defconfig
```kconfig
if SHIELD_DOTKEEB_LEFT

config ZMK_KEYBOARD_NAME
    default "dotKeeb"

config ZMK_SPLIT_BLE_ROLE_CENTRAL
    default y

endif

if SHIELD_DOTKEEB_LEFT || SHIELD_DOTKEEB_RIGHT

config ZMK_SPLIT
	default y
endif
```
